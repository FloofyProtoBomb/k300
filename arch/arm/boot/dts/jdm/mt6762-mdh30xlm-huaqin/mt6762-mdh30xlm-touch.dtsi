/*
 * LG Electronics MT6765 HDK touch device tree source
 *
 * Copyright (c) 2018 LG Electronics Co., Ltd.
 *              http://www.lge.com
 *
 */

#include "../mt6762-mdh30xlm-huaqin_touch_common/mt6762-mdh30xlm-touch.dtsi"

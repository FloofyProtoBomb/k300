## drivers/input/touchscreen/lge/jdm/Kconfig
```kconfig
#
# LGE touch core configuration
#
if INPUT_TOUCHSCREEN

source "drivers/input/touchscreen/lge/jdm/huaqin/Kconfig"
source "drivers/input/touchscreen/lge/jdm/wingtech/Kconfig"
endif
```

## drivers/input/touchscreen/lge/jdm/huaqin/Kconfig
```kconfig
#
# LGE touch core configuration
#
if INPUT_TOUCHSCREEN

source "drivers/input/touchscreen/lge/jdm/huaqin/goodix/Kconfig"
source "drivers/input/touchscreen/lge/jdm/huaqin/focaltech/Kconfig"
endif
```

## drivers/input/touchscreen/lge/jdm/huaqin/focaltech/Kconfig
```kconfig
#
# LGE touch core configuration
#
if INPUT_TOUCHSCREEN

source "drivers/input/touchscreen/lge/jdm/huaqin/focaltech/ft5446/Kconfig"

endif
```

## drivers/input/touchscreen/lge/jdm/huaqin/goodix/Kconfig
```kconfig
#
# LGE touch core configuration
#
if INPUT_TOUCHSCREEN

source "drivers/input/touchscreen/lge/jdm/huaqin/goodix/gt917d/Kconfig"

endif
```

## drivers/input/touchscreen/lge/jdm/wingtech/Kconfig
```kconfig
#
# LGE touch core configuration
#
if INPUT_TOUCHSCREEN

source "drivers/input/touchscreen/lge/jdm/wingtech/focaltech/Kconfig"
source "drivers/input/touchscreen/lge/jdm/wingtech/ilitek/Kconfig"
endif
```

## drivers/input/touchscreen/lge/jdm/wingtech/focaltech/FT8615/Kconfig
```kconfig
#
# LGE touch core configuration
#
if INPUT_TOUCHSCREEN

menuconfig LGE_TOUCH_FOCALTECH_FT8615
	bool "LGE Touch Core ODM Device Driver - FT8615"
	depends on LGE_TOUCH_CORE_BASE
	help
	  If your device is ft8615, say Y
# To Do : Focal Tech Chipseet

endif
```

## drivers/input/touchscreen/lge/jdm/wingtech/focaltech/Kconfig
```kconfig
#
# LGE touch core configuration
#
if INPUT_TOUCHSCREEN

source "drivers/input/touchscreen/lge/jdm/wingtech/focaltech/FT8006P/Kconfig"
source "drivers/input/touchscreen/lge/jdm/wingtech/focaltech/FT8615/Kconfig"
endif
```

## drivers/input/touchscreen/lge/jdm/wingtech/ilitek/Kconfig
```kconfig
#
# LGE touch core configuration
#
if INPUT_TOUCHSCREEN

source "drivers/input/touchscreen/lge/jdm/wingtech/ilitek/ILI9881H/Kconfig"
source "drivers/input/touchscreen/lge/jdm/wingtech/ilitek/ILI7807G/Kconfig"
endif
```

## drivers/input/touchscreen/lge_pos/focaltech/Kconfig
```kconfig
#
# LGE touch core configuration
#
if INPUT_TOUCHSCREEN

source "drivers/input/touchscreen/lge_pos/focaltech/ft5446/Kconfig"

endif
```

## drivers/input/touchscreen/lge_pos/goodix/Kconfig
```kconfig
#
# LGE touch core configuration
#
if INPUT_TOUCHSCREEN

source "drivers/input/touchscreen/lge_pos/goodix/gt917d/Kconfig"

endif
```

## drivers/misc/mediatek/lcm/jdm/Kconfig
```kconfig
config JDM_LCM
	bool "Enable JDM LCM driver"
	default n
	help
	  define JDM LCM driver config to enable LCM driver.
	  Please make sure LG_LCM in xxxxx_defconfig.mk.

source "drivers/misc/mediatek/lcm/jdm/ft8006p_hdplus_dsi_vdo_auo/Kconfig"
source "drivers/misc/mediatek/lcm/jdm/st7703_hdplus_dsi_vdo_lce/Kconfig"
source "drivers/misc/mediatek/lcm/jdm/ft8615_hdplus_dsi_vdo_auo/Kconfig"
```

## sound/soc/codecs/cirrus/Kconfig
```kconfig
config SND_SOC_CS35L41
        tristate "Cirrus Logic CS35L41 CODEC (Stereo)"

config SND_SOC_CS35L41_SPI
	tristate "Cirrus Logic CS35L41 CODEC (SPI)"
	depends on SPI_MASTER
	select SND_SOC_CS35L41
	select REGMAP_SPI

config SND_SOC_CS35L41_I2C
	tristate "Cirrus Logic CS35L41 CODEC (I2C)"
	depends on I2C
	select SND_SOC_CS35L41

config SND_SOC_CS35L41_TEST
	tristate "Test Feature for cirrus cs35l41"

config SND_SOC_CS35L41_SINGLE
	tristate "Cirrus Logic CS35L41 CODEC (Mono)"

config SND_SOC_CS35L41_LGE
	tristate "Customization for cirrus cs35l41"
```

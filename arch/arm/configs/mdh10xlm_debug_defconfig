## arch/arm/configs/mdh10xlm_debug_defconfig
```kconfig
CONFIG_CROSS_COMPILE="arm-eabi-"
# CONFIG_LOCALVERSION_AUTO is not set
# CONFIG_FHANDLE is not set
CONFIG_SCHED_WALT=y
CONFIG_PSI=y
CONFIG_LOG_BUF_SHIFT=21
CONFIG_UCLAMP_TASK=y
CONFIG_UCLAMP_GROUPS_COUNT=32
CONFIG_CGROUP_DEBUG=y
CONFIG_UCLAMP_TASK_GROUP=y
CONFIG_CPUSETS=y
CONFIG_CGROUP_SCHEDTUNE=y
CONFIG_SCHED_TUNE=y
CONFIG_MEMCG=y
CONFIG_MEMCG_SWAP=y
CONFIG_DEFAULT_USE_ENERGY_AWARE=y
# CONFIG_RD_BZIP2 is not set
# CONFIG_RD_LZMA is not set
# CONFIG_RD_XZ is not set
# CONFIG_RD_LZO is not set
# CONFIG_RD_LZ4 is not set
CONFIG_SYSCTL_SYSCALL=y
# CONFIG_KALLSYMS_BASE_RELATIVE is not set
CONFIG_MTK_AB_OTA_UPDATER=y
CONFIG_CC_STACKPROTECTOR_STRONG=y
CONFIG_MODULE_SRCVERSION_ALL=y
CONFIG_MODULES=y
CONFIG_MODULE_UNLOAD=y
CONFIG_MODVERSIONS=y
CONFIG_MODULE_SIG=y
CONFIG_MODULE_SIG_FORCE=y
# CONFIG_BLK_DEV_BSG is not set
CONFIG_MACH_MT6765=y
CONFIG_SMP=y
CONFIG_SCHED_MC=y
CONFIG_HAVE_ARM_ARCH_TIMER=y
CONFIG_NR_CPUS=8
CONFIG_ARM_PSCI=y
CONFIG_PREEMPT=y
# CONFIG_HZ_100 is not set
# CONFIG_HZ_250 is not set
CONFIG_HZ_300=y
# CONFIG_HZ_1000 is not set
CONFIG_AEABI=y
CONFIG_HIGHMEM=y
# CONFIG_HIGHPTE is not set
CONFIG_BUG_ON_DATA_CORRUPTION=y
CONFIG_ARM_MODULE_PLTS=y
CONFIG_CMA_AREAS=1
CONFIG_ZSMALLOC=y
CONFIG_MIGRATE_HIGHORDER=y
CONFIG_HIGHORDER_PAGES=18432
CONFIG_BUILD_ARM_APPENDED_DTB_IMAGE=y
CONFIG_BUILD_ARM_APPENDED_DTB_IMAGE_NAMES="mt6765"
CONFIG_BUILD_ARM_DTB_OVERLAY_IMAGE_NAMES="jdm/mt6762-mdh10xlm-huaqin"
CONFIG_CMDLINE="console=tty0 console=ttyMT3,921600n1 root=/dev/ram vmalloc=496M slub_max_order=0 slub_debug=O "
CONFIG_CPU_FREQ=y
CONFIG_CPU_FREQ_STAT=y
CONFIG_CPU_FREQ_STAT_DETAILS=y
CONFIG_CPU_FREQ_DEFAULT_GOV_PERFORMANCE=y
CONFIG_CPU_FREQ_GOV_POWERSAVE=y
CONFIG_CPU_FREQ_GOV_USERSPACE=y
CONFIG_CPU_FREQ_GOV_ONDEMAND=y
CONFIG_LGE_PM_MTK_POWERTOP=y
CONFIG_VFP=y
CONFIG_NEON=y
# CONFIG_CORE_DUMP_DEFAULT_ELF_HEADERS is not set
CONFIG_WQ_POWER_EFFICIENT_DEFAULT=y
CONFIG_XFRM_MIGRATE=y
CONFIG_IP_PNP=y
CONFIG_IP_PNP_DHCP=y
CONFIG_IP_PNP_BOOTP=y
CONFIG_NET_IPIP=y
CONFIG_IP_MROUTE=y
CONFIG_IP_MROUTE_MULTIPLE_TABLES=y
CONFIG_IP_PIMSM_V1=y
CONFIG_IP_PIMSM_V2=y
CONFIG_SYN_COOKIES=y
CONFIG_DEFAULT_BIC=y
CONFIG_IPV6_SIT_6RD=y
CONFIG_IPV6_SUBTREES=y
CONFIG_IPV6_MROUTE=y
CONFIG_IPV6_PIMSM_V2=y
CONFIG_BRIDGE_NETFILTER=y
# 2017-12-22 samuel.seo@lge.com Tethering problem fix by CR#2140125 [START]
CONFIG_NF_CT_NETLINK_HELPER=y
CONFIG_NETFILTER_NETLINK_QUEUE=y
CONFIG_NETFILTER_NETLINK_GLUE_CT=y
CONFIG_NETFILTER_XT_TARGET_CT=y
# 2017-12-22 samuel.seo@lge.com Tethering problem fix by CR#2140125 [END]
CONFIG_NETFILTER_XT_MATCH_CONNBYTES=y
CONFIG_NETFILTER_XT_MATCH_MULTIPORT=y
CONFIG_NETFILTER_XT_MATCH_PHYSDEV=y
CONFIG_NETFILTER_XT_MATCH_QUOTA2_LOG=y
CONFIG_NETFILTER_XT_MATCH_REALM=y
CONFIG_NETFILTER_XT_MATCH_RECENT=y
CONFIG_NETFILTER_XT_MATCH_TCPMSS=y
CONFIG_IP6_NF_MATCH_FRAG=y
CONFIG_IP6_NF_MATCH_IPV6HEADER=y
CONFIG_IP6_NF_TARGET_HL=y
CONFIG_BRIDGE=y
CONFIG_VLAN_8021Q=y
CONFIG_NET_SCH_INGRESS=y
CONFIG_NET_CLS_FW=y
CONFIG_CLS_U32_PERF=y
CONFIG_CLS_U32_MARK=y
CONFIG_NET_CLS_FLOW=y
CONFIG_NET_ACT_POLICE=y
CONFIG_NET_ACT_MIRRED=y
CONFIG_NET_ACT_IPT=y
CONFIG_NET_CLS_IND=y
CONFIG_CFG80211=y
CONFIG_NL80211_TESTMODE=y
CONFIG_CFG80211_DEVELOPER_WARNINGS=y
# CONFIG_CFG80211_DEFAULT_PS is not set
CONFIG_CFG80211_DEBUGFS=y
CONFIG_CFG80211_INTERNAL_REGDB=y
CONFIG_MTK_NET_LOGGING=y
CONFIG_ZRAM=y
CONFIG_BLK_DEV_LOOP=y
CONFIG_BLK_DEV_LOOP_MIN_COUNT=16
CONFIG_MEDIATEK_SOLUTION=y
CONFIG_MTK_PLATFORM="mt6765"
CONFIG_ARCH_MTK_PROJECT="muse6762_dh10x_q"
CONFIG_MTK_ENG_BUILD=y
CONFIG_MTK_GPT_SCHEME_SUPPORT=y
CONFIG_MTK_IO_BOOST=y
CONFIG_MTK_PID_MAP=y
CONFIG_MTK_FREQ_HOPPING=y
CONFIG_MTK_CPU_FREQ=y
CONFIG_MTK_PTPOD=y
CONFIG_MTK_STATIC_POWER=y
CONFIG_MTK_UNIFY_POWER=y
CONFIG_MTK_CM_MGR=y
CONFIG_LGE_PM_MTK_GAME_MODE=y
CONFIG_LGE_PM_TMR=y
CONFIG_MTK6765_FREQ_HOPPING=y
CONFIG_MTK_PMIC_NEW_ARCH=y
CONFIG_MTK_PMIC_COMMON=y
CONFIG_MTK_PMIC_CHIP_MT6357=y
CONFIG_MTK_EXTBUCK=y
CONFIG_MTK_AUXADC_INTF=y
CONFIG_REGULATOR_RT5738=y
CONFIG_MFD_MT6370_PMU=y
CONFIG_MT6370_PMU_CHARGER=y
CONFIG_MT6370_PMU_FLED=y
CONFIG_MT6370_PMU_BLED=y
CONFIG_MT6370_PMU_LDO=y
# CONFIG_MT6370_PMU_DSV is not set
CONFIG_MT6370_PMU_RGBLED=y
CONFIG_MTK_PMIC_WRAP_HAL=y
CONFIG_MTK_THERMAL_PA_VIA_ATCMD=y
CONFIG_LGE_PM_VTS=y
CONFIG_CUSTOM_KERNEL_IMGSENSOR="hi1336_mipi_raw gc8034_mipi_raw hi556_mipi_raw"
CONFIG_IMGSENSOR_MAIN="hi1336_mipi_raw"
CONFIG_IMGSENSOR_MAIN2="hi556_mipi_raw"
CONFIG_IMGSENSOR_SUB="gc8034_mipi_raw"
CONFIG_MTK_VIDEOCODEC_DRIVER=y
CONFIG_MTK_CAMERA_ISP_DPE_SUPPORT=y
CONFIG_MTK_SMI_EXT=y
CONFIG_MTK_CMDQ=y
CONFIG_MTK_CQDMA=y
CONFIG_MTK_IMGSENSOR=y
CONFIG_MTK_CAM_CAL=y
CONFIG_MTK_JPEG=y
### DISPLAY CONFIGURATION S
CONFIG_MTK_LCM=y
CONFIG_JDM_LCM=y
CONFIG_CUSTOM_KERNEL_LCM="ili9881c_hdplus_dsi_vdo_lce jd9365d_hdplus_dsi_vdo_hlt st7703_hdplus_dsi_vdo_lce"
CONFIG_CUSTOM_KERNEL_CHARGEPUMP=y
CONFIG_CUSTOM_KERNEL_CHARGEPUMP_LIST="sm5109"
CONFIG_ST7703_HDPLUS_DSI_VDO_LCE=y
CONFIG_LGE_SET_LCD_BIAS=y
CONFIG_LGE_DISPLAY_ESD_RECOVERY=y
CONFIG_LGE_USE_MTK_ESD_RECOVERY=y
CONFIG_LGE_VSYNC_SKIP=y
CONFIG_LGE_INTERVAL_MONITOR=y
CONFIG_LGE_FBCN=y
CONFIG_LGE_USE_BRIGHTNESS_TABLE=y
CONFIG_LGE_BRIGHTNESS_TABLE_DUALIZATION=y
CONFIG_LGE_LCM_SETTING=y
CONFIG_LGE_DSI_PARAM_TUNING=y
CONFIG_LGE_BACKLIGHT_BRIGHTNESS_TUNING=y
CONFIG_LGE_LCM_BACKLIGHT_PWM=y
CONFIG_LGE_DISPLAY_ESD_DUMMY_REGISTER=y
# CONFIG_LGE_INIT_CMD_TUNING is not set
CONFIG_LGE_LCD_OFF_DIMMING=y
# CONFIG_LGE_USE_TOUCH_NOTIFIER is not set
CONFIG_MTK_SYNC=y
CONFIG_MTK_FB=y
CONFIG_MTK_LCM_PHYSICAL_ROTATION="0"
CONFIG_MTK_ROUND_CORNER_SUPPORT=y
CONFIG_LCM_HEIGHT="1520"
CONFIG_LCM_WIDTH="720"
CONFIG_MTK_AAL_SUPPORT=y
CONFIG_MTK_DYNAMIC_FPS_FRAMEWORK_SUPPORT=y
CONFIG_MTK_SENSOR_SUPPORT=y
CONFIG_MTK_SENSORS_1_0=y
CONFIG_CUSTOM_KERNEL_ACCELEROMETER=y
CONFIG_MTK_ACCELHUB=y
CONFIG_CUSTOM_KERNEL_GYROSCOPE=y
CONFIG_MTK_GYROHUB=y
CONFIG_CUSTOM_KERNEL_ALSPS=y
CONFIG_MTK_ALSPSHUB=y
CONFIG_CUSTOM_KERNEL_MAGNETOMETER=y
CONFIG_MTK_MAGHUB=y
CONFIG_MTK_HWMON=y
CONFIG_CUSTOM_KERNEL_SENSOR_CAL=y
# CONFIG_CUSTOM_KERNEL_BAROMETER is not set
# CONFIG_MTK_BAROHUB is not set
CONFIG_CUSTOM_KERNEL_STEP_COUNTER=y
CONFIG_MTK_STEPSIGNHUB=y
CONFIG_CUSTOM_KERNEL_SITUATION=y
# CONFIG_MTK_WAKEHUB is not set
# CONFIG_MTK_GLGHUB is not set
CONFIG_MTK_DEVICE_ORIENTATION_HUB=y
# CONFIG_MTK_TILTDETECTHUB is not set
CONFIG_MTK_INPKHUB=y
CONFIG_CUSTOM_KERNEL_SENSORHUB=y
CONFIG_MTK_FINGERPRINT_SUPPORT=y
CONFIG_FINGERPRINT_CDFINGER=y
CONFIG_FINGERPRINT_ID_HI_CDFINGER=y
CONFIG_FINGERPRINT_FOCALTECH=y
CONFIG_FINGERPRINT_ID_LO_FOCALTECH=y
CONFIG_LGE_USE_SAR_CONTROLLER=y
CONFIG_INPUT_SAR_ATMF04MQF=y
CONFIG_MTK_MD1_SUPPORT=12
CONFIG_MTK_C2K_LTE_MODE=2
CONFIG_MTK_COMBO=y
CONFIG_MTK_COMBO_CHIP_CONSYS_6765=y
CONFIG_MTK_COMBO_BT=y
CONFIG_MTK_COMBO_GPS=y
CONFIG_MTK_COMBO_WIFI=y
CONFIG_MTK_PASSPOINT_R2_SUPPORT=y
CONFIG_MTK_DHCPV6C_WIFI=y
CONFIG_MTK_GPS_SUPPORT=y
CONFIG_MTK_FMRADIO=y
CONFIG_MTK_FM_CHIP="MT6631_FM"
CONFIG_MTK_CONNSYS_DEDICATED_LOG_PATH=y
CONFIG_MTK_ECCCI_DRIVER=y
CONFIG_MTK_ECCCI_C2K=y
CONFIG_MTK_SYNC_C2K_MEID=y
# NFC Driver
CONFIG_LGE_NFC=y
CONFIG_LGE_NFC_PN553=y
CONFIG_LGE_NFC_DEBUG_MESSAGE=y
CONFIG_MTK_BTIF=y
CONFIG_MTK_SECURITY_SW_SUPPORT=y
CONFIG_MTK_ACCDET=y
CONFIG_LGE_ACCDET=y
CONFIG_FOUR_KEY_HEADSET=y
CONFIG_ACCDET_EINT_IRQ=y
CONFIG_ACCDET_SUPPORT_EINT0=y
CONFIG_SWITCH=y
CONFIG_MTK_DRAM_LOG_STORE=y
CONFIG_MTK_DRAM_LOG_STORE_ADDR=0x0010E700
CONFIG_MTK_DRAM_LOG_STORE_SIZE=0x100
CONFIG_MTK_AUXADC=y
CONFIG_MTK_DEVAPC_DRIVER=y
CONFIG_MTK_LEDS=y
CONFIG_MTK_PWM=y
CONFIG_MTK_VIBRATOR=y
CONFIG_LGE_VIBRATOR_TEST=y
CONFIG_MTK_CHIP=y
CONFIG_MTK_USER_SPACE_GLOBAL_CPUSET=y
CONFIG_MTK_IDLE_BALANCE_ENHANCEMENT=y
CONFIG_MTK_RT_THROTTLE_MON=y
CONFIG_MTK_SCHED_EAS_POWER_SUPPORT=y
CONFIG_CPU_FREQ_GOV_SCHEDPLUS=y
CONFIG_SCHED_HMP=y
CONFIG_MTK_SCHED_BOOST=y
CONFIG_MTK_SCHED_RQAVG_KS=y
CONFIG_MTK_SCHED_RQAVG_US=y
CONFIG_MTK_SCHED_CPULOAD=y
CONFIG_MTK_SYSENV=y
CONFIG_MTK_TINYSYS_SCP_SUPPORT=y
CONFIG_MTK_TINYSYS_SSPM_SUPPORT=y
# CONFIG_MTK_USB_TYPEC_U3_MUX is not set
CONFIG_TCPC_CLASS=y
#CONFIG_USB_POWER_DELIVERY=y
CONFIG_TCPC_MT6370=y
CONFIG_MTK_GPU_SUPPORT=y
CONFIG_MTK_GPU_VERSION="rgx doma m1.9ED4940716"
CONFIG_MTK_GPU_COMMON_DVFS_SUPPORT=y
CONFIG_LGE_PM_GPU_UTILITY=y
CONFIG_MTK_CCU=y
CONFIG_MTK_RTC=y
CONFIG_MTK_RAM_CONSOLE=y
CONFIG_MTK_AEE_FEATURE=y
CONFIG_MTK_AEE_MRDUMP=y
CONFIG_MTK_LENS=y
CONFIG_MTK_FLASHLIGHT=y
CONFIG_MTK_FLASHLIGHT_MT6370=y
CONFIG_MTK_FLASHLIGHT_PT=y
CONFIG_MTK_FLASHLIGHT_PT_STRICT=y
CONFIG_MTK_FLASHLIGHT_DLPT=y
CONFIG_RT_FLASHLIGHT=y
CONFIG_USB_MTK_HDRC=y
CONFIG_MTK_MUSB_QMU_SUPPORT=y
CONFIG_MTK_MUSB_QMU_PURE_ZLP_SUPPORT=y
CONFIG_USB_MTK_OTG=y
CONFIG_MTK_PERFMGR_TOUCH_BOOST=y
CONFIG_MTK_CPU_CTRL_CFP=y
CONFIG_MTK_TC1_FEATURE=y
CONFIG_MTK_FPSGO_V3=y
CONFIG_MTK_TC1_FEATURE=y
CONFIG_MTK_PERF_TRACKER=y
CONFIG_MTK_LOWMEM_HINT=y
CONFIG_MTK_MEMCFG=y
# CONFIG_LOG_TOO_MUCH_WARNING is not set
CONFIG_MTPROF=y
CONFIG_MTK_SCHED_MONITOR=y
CONFIG_PREEMPT_MONITOR=y
CONFIG_MTK_WQ_DEBUG=y
CONFIG_MTK_RCU_MONITOR=y
CONFIG_ANDROID_DEFAULT_SETTING=y
CONFIG_MTK_FD_LEAK_DETECT=y
CONFIG_MTK_FD_LEAK_SPECIFIC_DEBUG=y
CONFIG_SCSI=y
CONFIG_BLK_DEV_SD=y
CONFIG_SCSI_SCAN_ASYNC=y
CONFIG_MD=y
CONFIG_BLK_DEV_DM=y
CONFIG_DM_BOW=y
CONFIG_DM_DEBUG=y
CONFIG_DM_CRYPT=y
CONFIG_DM_UEVENT=y
CONFIG_DM_VERITY=y
CONFIG_DM_VERITY_FEC=y
CONFIG_DM_BUFIO_CACHE_SIZE_PER_CLIENT=33554432
CONFIG_MTK_HW_FDE=y
CONFIG_IFB=y
# CONFIG_ETHERNET is not set
CONFIG_PPP_FILTER=y
CONFIG_PPP_MULTILINK=y
CONFIG_PPPOE=y
CONFIG_PPP_ASYNC=y
CONFIG_PPP_SYNC_TTY=y
# CONFIG_INPUT_MOUSEDEV is not set
CONFIG_INPUT_EVDEV=y
# CONFIG_KEYBOARD_ATKBD is not set
CONFIG_KEYBOARD_MTK=y
# CONFIG_ONEKEY_REBOOT_NORMAL_MODE is not set
# CONFIG_ONEKEY_REBOOT_OTHER_MODE is not set
CONFIG_TWOKEY_REBOOT_NORMAL_MODE=y
CONFIG_TWOKEY_REBOOT_OTHER_MODE=y
CONFIG_KPD_PMIC_LPRST_TD=0
CONFIG_KPD_PWRKEY_USE_PMIC=y
CONFIG_MTK_MRDUMP_KEY=y
# CONFIG_INPUT_MOUSE is not set
CONFIG_INPUT_TOUCHSCREEN=y
CONFIG_LGE_TOUCH_CORE=y
CONFIG_LGE_TOUCH_CORE_MTK=y
CONFIG_LGE_TOUCH_FW_PATH="touch/mdh10x"
CONFIG_LGE_TOUCH_FOCALTECH_FT5446=y
CONFIG_LGE_TOUCH_GOODIX_GT917D=y
CONFIG_LGE_TOUCH_JDM=y
#CONFIG_LGE_TOUCH_ILITEK_ILI9881H is not set
# CONFIG_LGE_TOUCH_FOCALTECH_FT8006P is not set
#CONFIG_LGE_TOUCH_LGSIW_SW49107 is not set
CONFIG_LGE_TOUCH_MODULE_DETECT=y
CONFIG_GTP_DRIVER_SEND_CFG=y
CONFIG_GTP_CUSTOM_CFG=y
CONFIG_GTP_AUTO_UPDATE=y
CONFIG_GTP_REQUEST_FW_UPDATE=y
CONFIG_GTP_CREATE_WR_NODE=y
CONFIG_GTP_POWER_CTRL_SLEEP=y
CONFIG_INPUT_MISC=y
CONFIG_INPUT_UINPUT=y
# CONFIG_SERIO is not set
# CONFIG_VT is not set
CONFIG_LEGACY_PTY_COUNT=16
# CONFIG_DEVMEM is not set
# CONFIG_DEVKMEM is not set
CONFIG_SERIAL_8250=y
# CONFIG_SERIAL_8250_DEPRECATED_OPTIONS is not set
CONFIG_SERIAL_8250_CONSOLE=y
CONFIG_SERIAL_8250_NR_UARTS=2
CONFIG_SERIAL_8250_RUNTIME_UARTS=2
CONFIG_SERIAL_8250_MT6577=y
# CONFIG_HW_RANDOM is not set
CONFIG_I2C_MTK=y
CONFIG_SPI=y
CONFIG_SPI_MT65XX=y
CONFIG_MTK_GAUGE_VERSION=30
CONFIG_MTK_CHARGER=y
CONFIG_MTK_KERNEL_POWER_OFF_CHARGING=y
# CONFIG_MTK_PUMP_EXPRESS_PLUS_SUPPORT is not set
# CONFIG_MTK_PUMP_EXPRESS_PLUS_20_SUPPORT is not set
CONFIG_LGE_PM_APPLE_CHARGER=y
CONFIG_LGE_PM_BATTERY_CYCLE=y
CONFIG_LGE_PM_BATTERY_AGING_FACTOR=y
CONFIG_LGE_PM_BATTERY_ID=y
CONFIG_LGE_PM_BATTERY_NTC_TUNED=y
CONFIG_LGE_PM_BATTERY_PRESENT=y
CONFIG_LGE_PM_CHARGERLOGO=y
CONFIG_LGE_PM_CHARGER_CONTROLLER=y
CONFIG_LGE_PM_POWER_SYSFS=y
CONFIG_LGE_PM_PSEUDO_BATTERY=y
CONFIG_LGE_PM_USB_ID=y
CONFIG_LGE_PM_VOLTAGE_EXTENDED_REGULATOR=y
# CONFIG_LGE_PM_PSEUDO_HVDCP is not set
# CONFIG_HWMON is not set
CONFIG_THERMAL=y
CONFIG_THERMAL_DEFAULT_GOV_BACKWARD_COMPATIBLE=y
CONFIG_WATCHDOG=y
CONFIG_MTK_WATCHDOG_COMMON=y
CONFIG_MTK_WATCHDOG_COMMON_V2=y
CONFIG_REGULATOR=y
CONFIG_DRM=y
CONFIG_FB_MODE_HELPERS=y
CONFIG_FB_TILEBLITTING=y
CONFIG_LOGO=y
CONFIG_SOUND=y
CONFIG_SND=y
CONFIG_SND_SEQUENCER=y
CONFIG_SND_SEQ_DUMMY=y
CONFIG_SND_SEQUENCER_OSS=y
CONFIG_SND_HRTIMER=y
CONFIG_SND_DYNAMIC_MINORS=y
CONFIG_SND_VERBOSE_PRINTK=y
CONFIG_SND_DEBUG=y
CONFIG_SND_DEBUG_VERBOSE=y
CONFIG_SND_PCM_XRUN_DEBUG=y
# CONFIG_SND_SPI is not set
CONFIG_SND_USB_AUDIO=y
CONFIG_MTK_UAC_POWER_SAVING=y
CONFIG_SND_SOC=y
CONFIG_MTK_SND_SOC_CODEC="mt6357"
CONFIG_SND_SOC_MTK_BTCVSD=y
CONFIG_MTK_SND_SOC_NEW_ARCH=y
CONFIG_MTK_SND_HPIMP=y
# CONFIG_SND_SOC_RT5509 is not set
CONFIG_SND_SOC_AK4376=n
CONFIG_SND_SOC_AW87529=y
CONFIG_SND_SOC_AW87349=y
CONFIG_LGE_STEREO_SPEAKER=y
CONFIG_LGE_CODEC_INPUT_MUTE_CONTROL=y
CONFIG_MOISTURE_INT_SUPPORT=n
CONFIG_SOUND_PRIME=y
CONFIG_HIDRAW=y
CONFIG_UHID=y
CONFIG_HID_A4TECH=y
CONFIG_HID_APPLE=y
CONFIG_HID_BELKIN=y
CONFIG_HID_CHERRY=y
CONFIG_HID_CHICONY=y
CONFIG_HID_CYPRESS=y
CONFIG_HID_DRAGONRISE=y
CONFIG_HID_EZKEY=y
CONFIG_HID_KYE=y
CONFIG_HID_GYRATION=y
CONFIG_HID_TWINHAN=y
CONFIG_HID_KENSINGTON=y
CONFIG_HID_LOGITECH=y
CONFIG_HID_MAGICMOUSE=y
CONFIG_HID_MICROSOFT=y
CONFIG_HID_MONTEREY=y
CONFIG_HID_PANTHERLORD=y
CONFIG_HID_PETALYNX=y
CONFIG_HID_SAMSUNG=y
CONFIG_HID_SUNPLUS=y
CONFIG_HID_GREENASIA=y
CONFIG_HID_SMARTJOYPLUS=y
CONFIG_HID_TOPSEED=y
CONFIG_HID_THRUSTMASTER=y
CONFIG_HID_ZEROPLUS=y
CONFIG_USB=y
CONFIG_USB_STORAGE=y
CONFIG_USB_STORAGE_DATAFAB=y
CONFIG_USB_STORAGE_FREECOM=y
CONFIG_USB_STORAGE_ISD200=y
CONFIG_USB_STORAGE_USBAT=y
CONFIG_USB_STORAGE_SDDR09=y
CONFIG_USB_STORAGE_SDDR55=y
CONFIG_USB_STORAGE_JUMPSHOT=y
CONFIG_USB_STORAGE_ALAUDA=y
CONFIG_USB_STORAGE_ONETOUCH=y
CONFIG_USB_STORAGE_KARMA=y
CONFIG_USB_STORAGE_CYPRESS_ATACB=y
CONFIG_USB_TRANCEVIBRATOR=y
CONFIG_NOP_USB_XCEIV=y
CONFIG_DUAL_ROLE_USB_INTF=y
CONFIG_USB_GADGET_VBUS_DRAW=500
CONFIG_USB_CONFIGFS_SERIAL=y
CONFIG_USB_CONFIGFS_ACM=y
CONFIG_USB_CONFIGFS_RNDIS=y
CONFIG_USB_CONFIGFS_MASS_STORAGE=y
CONFIG_USB_CONFIGFS_F_HID=y
CONFIG_LGE_USB_GADGET=y
CONFIG_LGE_USB=y
CONFIG_LGE_USB_EMBEDDED_BATTERY=y
CONFIG_LGE_USB_TYPE_C=y
CONFIG_LGE_USB_FACTORY=y
# CONFIG_LGE_USB_GADGET_CDROM_MAC_SUPPORT is not set
# CONFIG_LGE_USB_GADGET_AUTORUN is not set
CONFIG_MMC=y
CONFIG_MMC_BLOCK_MINORS=32
CONFIG_MMC_MTK_PRO=y
CONFIG_MTK_EMMC_SUPPORT=y
CONFIG_MTK_EMMC_CACHE=y
CONFIG_MTK_EMMC_CQ_SUPPORT=y
CONFIG_NEW_LEDS=y
CONFIG_LEDS_CLASS=y
CONFIG_LEDS_TRIGGERS=y
CONFIG_LEDS_TRIGGER_TIMER=y
# CONFIG_RTC_SYSTOHC is not set
CONFIG_DMADEVICES=y
CONFIG_DMA_MTK_UART=y
CONFIG_SW_SYNC=y
CONFIG_ANDROID_INTF_ALARM_DEV=y
CONFIG_ION=y
CONFIG_MTK_ION=y
CONFIG_NANOHUB=y
CONFIG_NANOHUB_MTK_IPI=y
CONFIG_MAILBOX=y
CONFIG_MTK_CMDQ_MBOX=y
CONFIG_MACH_MT6762_DH10XLM=y
CONFIG_LGE_RTC_TIMESTAMP=y
CONFIG_LGE_PM=y
CONFIG_LGE_PM_DEBUG=y
CONFIG_LGE_LEDS=y
CONFIG_LGE_BOOT_MODE=y
CONFIG_LGE_HANDLE_PANIC=y
CONFIG_LGE_HANDLE_PANIC_MTK_EMI_MPU=y
CONFIG_LGE_SREADAHEAD=y
CONFIG_READAHEAD_MMAP_SIZE_ENABLE=y
CONFIG_READAHEAD_MMAP_PAGE_CNT=16
CONFIG_IIO=y
CONFIG_EXT4_FS=y
CONFIG_EXT4_FS_SECURITY=y
CONFIG_EXT4_ENCRYPTION=y
CONFIG_EXT4_DEBUG=y
CONFIG_QUOTA=y
CONFIG_QUOTA_NETLINK_INTERFACE=y
CONFIG_QFMT_V2=y
CONFIG_FUSE_FS=y
CONFIG_OVERLAY_FS=y
CONFIG_ISO9660_FS=y
CONFIG_JOLIET=y
CONFIG_ZISOFS=y
CONFIG_MSDOS_FS=y
CONFIG_VFAT_FS=y
CONFIG_TMPFS=y
CONFIG_SDCARD_FS=y
CONFIG_PSTORE=y
CONFIG_PSTORE_CONSOLE=y
CONFIG_PSTORE_PMSG=y
CONFIG_PSTORE_RAM=y
# CONFIG_NETWORK_FILESYSTEMS is not set
CONFIG_NLS_CODEPAGE_437=y
CONFIG_NLS_CODEPAGE_950=y
CONFIG_NLS_ASCII=y
CONFIG_NLS_ISO8859_1=y
CONFIG_NLS_UTF8=y
CONFIG_PRINTK_TIME=y
CONFIG_DYNAMIC_DEBUG=y
CONFIG_DEBUG_INFO=y
CONFIG_FRAME_WARN=1500
CONFIG_SLUB_DEBUG_ON=y
CONFIG_DEBUG_KMEMLEAK=y
CONFIG_DEBUG_KMEMLEAK_EARLY_LOG_SIZE=3200
CONFIG_DEBUG_KMEMLEAK_DEFAULT_OFF=y
CONFIG_PANIC_ON_OOPS=y
CONFIG_PANIC_TIMEOUT=5
CONFIG_SCHEDSTATS=y
CONFIG_SCHED_STACK_END_CHECK=y
# CONFIG_PROVE_LOCKING is not set
# CONFIG_DEBUG_LOCKDEP is not set
CONFIG_DEBUG_ATOMIC_SLEEP=y
CONFIG_DEBUG_LIST=y
CONFIG_RCU_CPU_STALL_TIMEOUT=60
CONFIG_RCU_TRACE=y
CONFIG_FAULT_INJECTION=y
CONFIG_ENABLE_DEFAULT_TRACERS=y
CONFIG_MTK_SCHED_TRACERS=y
CONFIG_MTK_FTRACE_DEFAULT_ENABLE=y
CONFIG_DMA_API_DEBUG=y
CONFIG_KGDB=y
CONFIG_KGDB_KDB=y
# CONFIG_ARM_UNWIND is not set
CONFIG_SECURITY_SELINUX_BOOTPARAM=y
CONFIG_HIE=y
CONFIG_CRYPTO_XCBC=y
CONFIG_CRYPTO_TWOFISH=y
# CONFIG_CRYPTO_HW is not set
CONFIG_TRUSTONIC_TEE_SUPPORT=y
CONFIG_MTK_TEE_GP_SUPPORT=y
CONFIG_PPP=y
CONFIG_PPPOL2TP=y
CONFIG_PPPOLAC=y
CONFIG_PPPOPNS=y
CONFIG_PPP_MPPE=y
CONFIG_L2TP=y
CONFIG_XFRM_USER=y
CONFIG_NET_KEY=y
CONFIG_NETFILTER_XT_MATCH_POLICY=y
CONFIG_INET_IPCOMP=y
CONFIG_INET_AH=y
CONFIG_INET_ESP=y
CONFIG_CRYPTO_NULL=y
CONFIG_INET6_IPCOMP=y
CONFIG_INET6_AH=y
CONFIG_INET6_ESP=y
CONFIG_TUN=y
CONFIG_ECRYPT_FS=y
CONFIG_KEYS=y
CONFIG_ENCRYPTED_KEYS=y
CONFIG_LGE_QFPROM_INTERFACE=y
CONFIG_VPNCLIENT_SECURITY=m
CONFIG_LG_VPN_V38=y
# [SIMLOCK] LGE_NV_SIMLOCK [START]
CONFIG_MTK_SIM_LOCK_POWER_ON_WRITE_PROTECT=y
# [SIMLOCK] LGE_NV_SIMLOCK [END]
CONFIG_ARTIFICIAL_NEURAL_NETWORK=y
CONFIG_SCHED_MIGRATION_COST_POLICY_GRADIENT=y
CONFIG_CAPACITY_MARGIN_DVFS_POLICY_GRADIENT=y
```

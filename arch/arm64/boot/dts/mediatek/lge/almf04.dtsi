/*
 * LG Electronics atmf04 input device tree source
 *
 * Copyright (c) 2017 LG Electronics Co., Ltd.
 *              http://www.lge.com
 *
 */
sar_controller: almf04@5a {
	compatible = "adsemicon,almf04";
	reg = <0x5a>;
	status = "okay";
	interrupt-parent = <&pio>;
	interrupts = <0 8 IRQ_TYPE_EDGE_FALLING>;

	Adsemicon,irq-gpio = <&pio 15 0>;
	Adsemicon,chip_enable = <&pio 14 0>;
	Adsemicon,InputPinsNum = <2>;
	Adsemicon,fw_name = "almf04/almf04_2CH_V2.04T.fw";
};
